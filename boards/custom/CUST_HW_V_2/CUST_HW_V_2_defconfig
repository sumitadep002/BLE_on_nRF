## boards/custom/CUST_HW_V_2/CUST_HW_V_2_defconfig
```kconfig
CONFIG_ARM_MPU=y
CONFIG_HW_STACK_PROTECTION=y

# Logger
CONFIG_USE_SEGGER_RTT=y  # enable GPIO
CONFIG_GPIO=y  # enable uart driver
CONFIG_SERIAL=y  # enable console
CONFIG_CONSOLE=y
CONFIG_UART_CONSOLE=y

# Oscillators
CONFIG_CLOCK_CONTROL_NRF_K32SRC_RC=y
CONFIG_CLOCK_CONTROL_NRF_K32SRC_XTAL=n

#BLE
CONFIG_BT=y
CONFIG_BT_PERIPHERAL=y
CONFIG_BT_DEVICE_NAME="BLE-NODE"
```
